## app/boards/xiao_esp32s3_procpu.conf
```kconfig
# Enable drivers for peripherals
CONFIG_ADC=y
CONFIG_DISPLAY=y
CONFIG_DMA=y
CONFIG_ENTROPY_GENERATOR=y
CONFIG_GPIO=y
CONFIG_I2C=y
CONFIG_INPUT=y
CONFIG_PWM=y
CONFIG_REBOOT=y
CONFIG_REBOOT=y
CONFIG_SPI=y

# Enable sensor subsystem (doesn't add code if not used).
# Specific sensors should be enabled per-board.
CONFIG_SENSOR=y

# System settings
CONFIG_MAIN_STACK_SIZE=27648
CONFIG_USBD_MSC_STACK_SIZE=8192
# reduce heap size if memory is needed elsewhere
CONFIG_MICROPY_HEAP_SIZE=204800

CONFIG_LOG=y
CONFIG_FPU=y
CONFIG_POLL=y

CONFIG_MICROPY_FROZEN_MANIFEST="boards/xiao_esp32s3_procpu/manifest.py"

# Required for zephyr.shell_exec()
CONFIG_CONSOLE_HANDLER=y
CONFIG_SERIAL=y
CONFIG_SHELL_BACKEND_SERIAL_INTERRUPT_DRIVEN=n
CONFIG_SHELL_BACKEND_SERIAL_LOG_LEVEL_ERR=y
CONFIG_SHELL=y
CONFIG_STDOUT_CONSOLE=y
CONFIG_UART_CONSOLE_DEBUG_SERVER_HOOKS=y
CONFIG_UART_INTERRUPT_DRIVEN=y
CONFIG_UART_LINE_CTRL=y
CONFIG_UART_USE_RUNTIME_CONFIGURE=y
# prompt off
CONFIG_SHELL_PROMPT_UART=""

# this is a crude hack to work around a crash while not dumping evey syscall
CONFIG_EXCEPTION_DUMP_HOOK=y
CONFIG_EXCEPTION_DUMP_HOOK_ONLY=y
CONFIG_LOG_PRINTK=n

## Non-Volatile Memory and File System
CONFIG_DISK_ACCESS=y
CONFIG_USB_DEVICE_STACK_NEXT=y
CONFIG_CDC_ACM_SERIAL_INITIALIZE_AT_BOOT=n
CONFIG_USBD_CDC_ACM_LOG_LEVEL_OFF=y
CONFIG_USBD_MSC_CLASS=y
CONFIG_USBD_MSC_LUNS_PER_INSTANCE=2
CONFIG_SD_DATA_TIMEOUT=25000
CONFIG_SD_DATA_RETRIES=5
CONFIG_HEAP_MEM_POOL_SIZE=10240
CONFIG_FLASH=y
CONFIG_FLASH_MAP=y
CONFIG_FILE_SYSTEM=y
CONFIG_FILE_SYSTEM_MKFS=y
CONFIG_FS_FATFS_LFN=y
CONFIG_FS_FATFS_LFN_MODE_STACK=y
CONFIG_FS_FATFS_REENTRANT=y
CONFIG_FAT_FILESYSTEM_ELM=y
CONFIG_MICROPY_VFS_FAT=n
CONFIG_MICROPY_VFS_LFS1=n
CONFIG_MICROPY_VFS_LFS2=n
```

## west.yml
```yaml
# Copyright (c) 2021 Nordic Semiconductor ASA
# SPDX-License-Identifier: Apache-2.0

manifest:
  self:
    west-commands: scripts/west-commands.yml
    path: mp-lvgl-example

  remotes:
    - name: zephyrproject-rtos
      url-base: https://github.com/zephyrproject-rtos
    - name: micropython
      url-base: https://github.com/micropython
    - name: lvgl
      url-base: https://github.com/lvgl
    - name: marble
      url-base: https://github.com/cyber-murmel

  projects:
    - name: zephyr
      remote: marble
      revision: 151046a633fbf08c2878e1c5f2be9227bc553abd
      path: modules/zephyr
      import:
        name-allowlist:
          - hal_espressif
          - mcuboot
          - fatfs
          - lvgl
    - name: micropython
      remote: micropython
      revision: 9faaa837f47efe76b57e337e5d30e07fcd10be1a
      path: modules/micropython
    - name: lv_binding_micropython
      remote: marble
      revision: mp-lvgl
      path: modules/lib/gui/lv_binding_micropython
      import:
        name-allowlist:
          - pycparser
    - name: micropython-lib
      remote: micropython
      revision: v1.29.0
      path: modules/micropython/lib/micropython-lib
```
